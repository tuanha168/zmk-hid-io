## dts/bindings/zmk,behavior-hid-io-gamepad-axis.yaml
```yaml
description: HID gamepad digital axis behavior

compatible: "zmk,behavior-hid-io-gamepad-axis"

include: two_param.yaml
```

## dts/bindings/zmk,behavior-hid-io-gamepad-button.yaml
```yaml
description: HID gamepad button behavior

compatible: "zmk,behavior-hid-io-gamepad-button"

include: one_param.yaml
```
